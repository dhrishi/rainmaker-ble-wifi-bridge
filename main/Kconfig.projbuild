## main/Kconfig.projbuild
```kconfig
menu "Example Configuration"

    config APP_PROV_SHOW_QR
        bool "Show provisioning QR code"
        default y
        help
            Show the QR code for provisioning.

endmenu
```
